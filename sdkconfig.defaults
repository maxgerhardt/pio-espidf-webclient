## sdkconfig.defaults
```kconfig
CONFIG_WEBSOCKET_URI_FROM_STDIN=n
CONFIG_WEBSOCKET_URI_FROM_STRING=y
CONFIG_EXAMPLE_CONNECT_ETHERNET=n
CONFIG_EXAMPLE_CONNECT_WIFI=y
#CONFIG_ESP_WS_CLIENT_ENABLE_DYNAMIC_BUFFER=y
#CONFIG_WS_OVER_TLS_MUTUAL_AUTH=y
#CONFIG_WS_OVER_TLS_SKIP_COMMON_NAME_CHECK=y
CONFIG_WS_OVER_TLS_SERVER_AUTH=y
```
